## boards/shields/klor/Kconfig.defconfig
```kconfig
if SHIELD_KLOR_RIGHT

config ZMK_KEYBOARD_NAME
    default "Sanne's KLOR"

config ZMK_SPLIT_ROLE_CENTRAL
    default y

endif # SHIELD_KLOR_LEFT

if SHIELD_KLOR_LEFT || SHIELD_KLOR_RIGHT

config ZMK_SPLIT
    default y

endif # SHIELD_KLOR_LEFT || SHIELD_KLOR_RIGHT
```
